## test/Kconfig
```kconfig
#
# DOPANIC device configuration
#

menu "DOPANIC"
config DOPANIC
       tristate 'Do Panic'
       help
         This causes a Linux kernel panic when loaded.
	 If unsure, say N.

endmenu
```
